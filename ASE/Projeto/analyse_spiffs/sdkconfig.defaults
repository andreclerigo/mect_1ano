## ASE/Projeto/analyse_spiffs/sdkconfig.defaults
```kconfig
CONFIG_ESPTOOLPY_FLASHMODE_STR=y
CONFIG_ESPTOOLPY_FLASHFREQ_40M=y
CONFIG_ESPTOOLPY_FLASHSIZE_4MB=y
CONFIG_PARTITION_TABLE_CUSTOM=y
CONFIG_PARTITION_TABLE_CUSTOM_FILENAME="partitions.csv"
CONFIG_PARTITION_TABLE_OFFSET=0x8000
```

## ASE/Projeto/rover/components/buzzer/Kconfig.projbuild
```kconfig
menu "Buzzer Configuration"
    config BUZZER_PIN
        int "Buzzer GPIO PIN"
        default 16
        help
            The GPIO pin that the buzzer is connected to.
endmenu
```

## ASE/Projeto/rover/components/dht11/Kconfig.projbuild
```kconfig
menu "DHT11 Configuration"

    config DHT11_PIN
        int "DHT11 GPIO PIN"
        default 4
        help
            The GPIO pin that the DHT11 sensor is connected to.
endmenu
```

## ASE/Projeto/rover/components/eeprom_25LC040A/Kconfig.projbuild
```kconfig
menu "EEPROM Configuration"
    config EEPROM_CS_PIN
        int "EEPROM Chip Select GPIO PIN"
        default 5
        help
            The GPIO pin that the EEPROM chip select is connected to.
    
    config EEPROM_SCK_PIN
        int "EEPROM Clock GPIO PIN"
        default 18
        help
            The GPIO pin that the EEPROM clock is connected to.

    config EEPROM_MOSI_PIN
        int "EEPROM MOSI GPIO PIN"
        default 23
        help
            The GPIO pin that the EEPROM MOSI is connected to.
    
    config EEPROM_MISO_PIN
        int "EEPROM MISO GPIO PIN"
        default 19
        help
            The GPIO pin that the EEPROM MISO is connected to.
    
    config EEPROM_CLK_SPEED_HZ
        int "EEPROM Clock Speed (Hz)"
        default 1000000
        help
            The clock speed of the EEPROM in Hz.
endmenu
```

## ASE/Projeto/rover/components/mq5/Kconfig.projbuild
```kconfig
menu "MQ5 Configuration"

    config MQ5_PIN
        int "MQ5 GPIO PIN"
        default 6
        help
            The GPIO pin that the MQ5 sensor is connected to.
endmenu
```

## ASE/Projeto/rover/components/ssd1306/Kconfig.projbuild
```kconfig
menu "SSD1306 Configuration"
    config SSD1306_SCL_PIN
        int "SSD1306 SCL GPIO PIN"
        default 33
        help
            The GPIO pin that the SS1306 SCL is connected to.

    config SSD1306_SDA_PIN
        int "SSD1306 SDA GPIO PIN"
        default 32
        help
            The GPIO pin that the SS1306 SDA is connected to.
endmenu
```

## ASE/Projeto/rover/main/Kconfig.projbuild
```kconfig
menu "WiFi Configuration"

    config WIFI_SSID
        string "WiFi SSID"
        # default "OpenLab"
        default "devolo-983"
        help
            SSID (network name) for the device to connect to.

    config WIFI_PASS
        string "WiFi Password"
        # default "open.LAB"
        default "FUAVIMCRSULJVNMR"
        help
            WiFi password for the network that the device will to use.

    config SERVER_IP_ADDR
        string "Server IP address"
        default "192.168.1.120"
        help
            IP address of the server to connect to and send the sensor data.
endmenu
```
